## conf/layer.conf
```bitbake
# We have a conf and classes directory, add to BBPATH
BBPATH .= ":${LAYERDIR}"

# We have recipes-* directories, add to BBFILES
BBFILES += "${LAYERDIR}/recipes-*/*/*.bb \
            ${LAYERDIR}/recipes-*/*/*.bbappend"

BBFILE_COLLECTIONS += "meta-zturn"
BBFILE_PATTERN_meta-zturn = "^${LAYERDIR}/"
BBFILE_PRIORITY_meta-zturn = "6"

LAYERDEPENDS_meta-zturn = "core"
#LAYERSERIES_COMPAT_meta-zturn = "thud"
LAYERSERIES_COMPAT_meta-zturn = "zeus"

# hack for meta-xilinx-tools being bad
XILINX_VER_MAIN ?= "2020.1"
```

## conf/machine/zturn-zynq7.conf
```bitbake
#@TYPE: Machine
#@NAME: zturn-zynq7
#@DESCRIPTION: Machine support for Z-turn.
#
# For details on the Z-turn board:
#     http://www.myirtech.com/list.asp?id=502
#

SOC_VARIANT ?= "7z"

require conf/machine/include/tune-zynq.inc
require conf/machine/include/machine-xilinx-overrides.inc
require conf/machine/include/machine-xilinx-default.inc

MACHINE_FEATURES = "ext2 vfat usbhost usbgadget serial"

# u-boot configuration
PREFERRED_PROVIDER_virtual/bootloader = "u-boot-xlnx"
PREFERRED_PROVIDER_virtual/boot-bin = "xilinx-bootbin"
UBOOT_MACHINE = "zynq_z_turn_config"
SPL_BINARY = "spl/boot.bin"

EXTRA_IMAGEDEPENDS += " \
		u-boot-zynq-uenv \
		virtual/boot-bin \
		virtual/bootloader \
		"

SERIAL_CONSOLE = "115200 ttyPS0"

KERNEL_DEVICETREE = "zynq-zturn.dtb"

IMAGE_BOOT_FILES += " \
		boot.bin \
		uEnv.txt \
		"
YAML_SERIAL_CONSOLE_STDOUT = "ps7_uart_1"
YAML_SERIAL_CONSOLE_STDIN = "ps7_uart_1"
YAML_CONSOLE_DEVICE_CONFIG = "ps7_uart_1"
```
